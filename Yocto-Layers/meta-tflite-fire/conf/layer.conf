## Yocto-Layers/meta-tflite-fire/conf/layer.conf
```bitbake
# We have a conf and classes directory, add to BBPATH
BBPATH .= ":${LAYERDIR}"

# We have recipes-* directories, add to BBFILES
BBFILES += "${LAYERDIR}/recipes-*/*/*.bb \
            ${LAYERDIR}/recipes-*/*/*.bbappend"

BBFILE_COLLECTIONS += "meta-tflite-fire"
BBFILE_PATTERN_meta-tflite-fire = "^${LAYERDIR}/"
BBFILE_PRIORITY_meta-tflite-fire = "6"

LAYERDEPENDS_meta-tflite-fire = "core"
LAYERSERIES_COMPAT_meta-tflite-fire = "dunfell"
```
